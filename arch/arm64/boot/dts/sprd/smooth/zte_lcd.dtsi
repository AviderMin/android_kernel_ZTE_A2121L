
#include "zte_lcd_lianchuang_ili9881c_qc_6p_hd.dtsi"
#include "zte_lcd_huajiacai_ili9882n_huajiacai_6p_hd.dtsi"
#include "zte_lcd_skyworth_icnl9911_huajiacai_6p_hd.dtsi"
#include "zte_lcd_lianchuang_ft8006p_huajiacai_6p_hd.dtsi"
#include "zte_lcd_tongxingda_hx8394f_hsd_6p_hd.dtsi"
#include "zte_lcd_skyworth_icnl9911_huajiacai_6p_hd_3lane.dtsi"
#include "zte_lcd_skyworth_icnl9911s_huajiacai_6p_hd_3lane.dtsi"
#include "zte_lcd_skyworth_icnl9911c_huajiacai_6p_hd_3lane.dtsi"
#include "zte_lcd_lead_ft8006p_huajiacai_6p_hd.dtsi"

&dphy {
	/delete-property/ sprd,ulps-disabled;
};
&i2c4 {
	ti65132b@3e {
		compatible = "tps,ti65132b";
		reg = <0x3e>;
	};
};
