
#include "zte_lcd_lianchuang_icnl9911s_boe_6p82_hd_3lane.dtsi"
#include "zte_lcd_lianchuang_icnl9911c_boe_6p82_hd_3lane.dtsi"
#include "zte_lcd_lead_hx83102d_boe_6p82_hd_3lane.dtsi"

&dphy {
	/delete-property/ sprd,ulps-disabled;
};
&i2c4 {
	ti65132b@3e {
		compatible = "tps,ti65132b";
		reg = <0x3e>;
	};
};
