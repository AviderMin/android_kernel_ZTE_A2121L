/*
 * this file is ued to change sprd dtsi which can't be changed by overlay
 * such as /delete-node/ /delete-property/ and alises
 */


#include "zte_lcd.dtsi"
#include "touchscreen_donn.dtsi"
#include "zte_sar_donn.dtsi"
#include "../bat_setting/battery_protect_policy_080509200110.dtsi"
