
#include "zte_lcd_visionox_rm682c9_visionox_6p92_1080plus.dtsi"
#include "zte_lcd_visionox_rm682c9_90hz_visionox_6p92_1080plus.dtsi"


&dphy {
	/delete-property/ sprd,ulps-disabled;
};

&panel {
	avdd-gpio = <&ap_gpio 96 GPIO_ACTIVE_HIGH>;
	power-supply = <&vddkpled>;
};

&i2c4 {
	ti65132b@3e {
		compatible = "tps,ti65132b";
		reg = <0x3e>;
	};
};
